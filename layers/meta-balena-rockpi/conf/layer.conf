## layers/meta-balena-rockpi/conf/layer.conf
```bitbake
BBPATH .= ":${LAYERDIR}"

BBFILES += "${LAYERDIR}/recipes-*/*/*.bb \
            ${LAYERDIR}/recipes-*/*/*.bbappend"

BBFILE_COLLECTIONS += "balena-rockpi-s"
BBFILE_PATTERN_balena-rockpi-s := "^${LAYERDIR}/"
BBFILE_PRIORITY_balena-rockpi-s = "1337"

LAYERSERIES_COMPAT_balena-rockpi-s = "warrior"
```
